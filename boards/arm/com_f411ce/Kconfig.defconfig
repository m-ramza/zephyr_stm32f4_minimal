## boards/arm/com_f411ce/Kconfig.defconfig
```kconfig
# Copyright (c) 2020 Brian Bradley
# SPDX-License-Identifier: Apache-2.0

# F411CE based Black Pill V2.0+ board board configuration

if BOARD_COM_F411CE

config BOARD
	default "com_f411ce"

config SPI_STM32_INTERRUPT
	default y
	depends on SPI

endif # BOARD_COM_F411CE
```

## west.yml
```yaml
manifest:
  remotes:
    - name: zephyrproject-rtos
      url-base: https://github.com/zephyrproject-rtos
  projects:
    - name: zephyr
      remote: zephyrproject-rtos
      revision: v3.6.0
      west-commands: scripts/west-commands.yml
      import:
        name-allowlist:
        - hal_st
        - hal_stm32
        - cmsis

  self:
    path: zephyr_stm32f4_minimal
```
